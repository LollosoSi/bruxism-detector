// Comment here to read from analog_pin
//#define SIMULATION
//#define NIGHT_SIMULATION_SERIAL

#define SVM_KERNEL_LINEAR
//#define SVM_KERNEL_POLY


struct data_element {
  unsigned long timestamp = 0;
  bool value = 0;
};

static const unsigned int elements_size = 1000;
unsigned int elements_cursor = 0;
data_element data_elements[elements_size];

// Uses debounce by Aaron Kimball
#include <Arduino.h>
#include <debounce.h>

// Uses ArduinoFFT Library
#include "arduinoFFT.h"

// Physical Settings
#define analog_pin A0

// Connect a button to some GPIO pin
static constexpr int BUTTON = 3;
static constexpr int BUZZER = 5;

bool stream_FFT = false;


// FFT Settings
const uint16_t samples = 64;              // Must be a power of 2
const uint16_t samplingFrequency = 1000;  // Adjust as needed
const uint8_t amplitude = 255;
const float freq_increment = 10;
const float freq_bin = samplingFrequency / samples;

// There are two speedup options for some of the FFT code:

// Define this to use reciprocal multiplication for division and some more speedups that might decrease precision
#define FFT_SPEED_OVER_PRECISION

// Define this to use a low-precision square root approximation instead of the regular sqrt() call
// This might only work for specific use cases, but is significantly faster. Only works for ArduinoFFT<float>.
#define FFT_SQRT_APPROXIMATION



const uint8_t CLENCH_START = 0;
const uint8_t CLENCH_STOP = 1;
const uint8_t BUTTON_PRESS = 2;
const uint8_t ALARM_START = 3;
const uint8_t BEEP = 4;
const uint8_t UDP_ALARM_CONFIRMED = 5;
const uint8_t DETECTED = 6;
const uint8_t CONTINUED = 7;
const uint8_t ALARM_STOP = 8;

#ifdef NIGHT_SIMULATION_SERIAL
#include <cstring>
#include <String>

void send_event_serial(uint8_t event, unsigned long ms) {
  Serial.print(ms);
  Serial.print(";");
  Serial.print("simulation");
  Serial.print(";");

  switch (event) {
    default:
      //print("Received unrecognized byte value: ");
      //println((int)event);
      break;

    case CLENCH_START:
      Serial.print("Clenching");
      Serial.print(";");
      Serial.println("STARTED");
      break;

    case CLENCH_STOP:
      Serial.print("Clenching");
      Serial.print(";");
      Serial.println("STOPPED");
      break;

    case BUTTON_PRESS:
      Serial.println("Button");
      break;

    case ALARM_START:
      Serial.print("Alarm");
      Serial.print(";");
      Serial.println("STARTED");
      break;

    case ALARM_STOP:
      Serial.print("Alarm");
      Serial.print(";");
      Serial.println("STOPPED");
      break;

    case BEEP:
      Serial.print("Beep");
      Serial.print(";");
      Serial.println("WARNING BEEP");
      break;

    case DETECTED:
      Serial.print("Clenching");
      Serial.print(";");
      Serial.println("FIRST DETECTION");
      break;

    case CONTINUED:
      Serial.print("Clenching");
      Serial.print(";");
      Serial.println("CONTINUED");
      break;
  }
}

#endif

#if defined(ARDUINO_UNOR4_WIFI) | defined(ESP32)
#define WIFI_OUT true
#endif

#if defined(ARDUINO_UNOR4_WIFI)
// Uses ArduinoGraphics Library
// To use ArduinoGraphics APIs, please include BEFORE Arduino_LED_Matrix
#include "ArduinoGraphics.h"
#include "Arduino_LED_Matrix.h"  // Include the LED_Matrix library
ArduinoLEDMatrix matrix;         // Create an instance of the ArduinoLEDMatrix class
bool matrixon = false;
const uint32_t fullOn[] = {
  0xffffffff,
  0xffffffff,
  0xffffffff
};
#endif

#ifdef WIFI_OUT
#warning "Wifi out is enabled!"

#include <WiFi.h>
#include <WiFiUdp.h>

WiFiUDP udp;                                 // Define UDP object
WiFiUDP read_udp;                            // Define UDP object
IPAddress multicastAddress(239, 255, 0, 1);  // Multicast address
unsigned int multicastPort = 4000;           // Multicast port
unsigned int multicastReadPort = 4001;

const char* ssid = "YOUR SSID";
const char* password = "YOUR PASSWORD";
#endif

// FFT Settings
float freq = 0.0;
float vReal[samples];
float vImag[samples];
int network_send_bytes = (samples / 2) * sizeof(float);


ArduinoFFT<float> FFT = ArduinoFFT<float>(vReal, vImag, samples, samplingFrequency);




void collect_samples() {
  for (uint16_t i = 0; i < samples; i++) {
    vReal[i] = analogRead(analog_pin);
    vImag[i] = 0.0;
    delayMicroseconds(1000000 / samplingFrequency);
  }
}

void generate_samples() {
  double ratio = (2.0 * PI * freq) / samplingFrequency;  // Simulated 1000 Hz sine wave
  for (uint16_t i = 0; i < samples; i++) {
    vReal[i] = amplitude * sin(i * ratio);
    vImag[i] = 0.0;
  }

  freq += freq_increment;
  if (freq > samplingFrequency / 2)
    freq = 0;
}

void send_parameters_serial() {
  // Send samplingFrequency as uint16_t (Little-Endian)
  Serial.write(lowByte(samplingFrequency));
  Serial.write(highByte(samplingFrequency));

  // Send samples as uint16_t (Little-Endian)
  Serial.write(lowByte(samples));
  Serial.write(highByte(samples));
  Serial.flush();
}

void send_button_serial() {
}

void send_serial() {
  static uint8_t c = 0;

  Serial.write((uint8_t*)vReal, network_send_bytes);  // Send the FFT value as a single byte
  Serial.flush();                                     // Make sure the serial buffer is flushed
}



void nonwifi_setup() {

  Serial.begin(500000);
  while (!Serial) { delay(100); }
  send_parameters_serial();
}

bool alarm_running = 0;

long last_tone_ms = 0, last_flash = 0;

int tone_num = 4;
int tone_sel = tone_num - 1;
unsigned int tones[] = { 1567, 1760, 1975, 2093 };
unsigned int durations[] = { 200, 200, 200, 500 };
unsigned int waits[] = { 170, 170, 170, 4500 };

int warning_beep_duration = 100;
int warning_beep_wait = 50;

void alarm_loop() {
  if (alarm_running) {
    if (millis() - last_tone_ms >= waits[tone_sel]) {
      if (++tone_sel >= tone_num)
        tone_sel = 0;
      tone(BUZZER, tones[tone_sel], durations[tone_sel]);
      last_tone_ms = millis();
    }

    /*
#if defined(ARDUINO_UNOR4_WIFI)
    if (millis() - last_flash > 10) {
      if (matrixon)
        matrix.clear();
      else
        matrix.loadFrame(fullOn);
      matrixon = !matrixon;
      last_flash = millis();
    }
#endif
*/
  }
}

void trigger_alarm() {
  alarm_running = true;
}

void warning_beep() {
  tone(BUZZER, 2600, warning_beep_duration);
  delay(warning_beep_wait);
  tone(BUZZER, 2600, warning_beep_duration);
}

static void button_long_press(uint8_t btnId, uint8_t btnState);
static void button_short_press(uint8_t btnId, uint8_t btnState);

static Button button_input_short(0, button_short_press);
static Button button_input_long(1, button_long_press);

void setup() {

  //pinMode(BUZZER, OUTPUT);
  pinMode(BUTTON, INPUT_PULLUP);
  tone(BUZZER, 1500, warning_beep_duration);

  button_input_short.setPushDebounceInterval(10);
  button_input_long.setPushDebounceInterval(800);

#if defined(ARDUINO_UNOR4_WIFI)
  matrix.begin();  // Initialize the LED matrix
  matrix.beginDraw();

  matrix.stroke(0xFFFFFFFF);
  matrix.textScrollSpeed(100);

  const char text[] = "WiFi";
  matrix.textFont(Font_5x7);
  matrix.beginText(0, 1, 0xFFFFFF);
  matrix.println(text);
  matrix.endText(SCROLL_LEFT);


#endif


#ifdef WIFI_OUT
  wifi_setup();
#else
  nonwifi_setup();
#endif

#if defined(ARDUINO_UNOR4_WIFI)
  matrix.endDraw();
  matrix.clear();
#endif


  tone(BUZZER, 1800, 100);
}


#ifdef SVM_KERNEL_LINEAR
static const double weights[] = { 0.0, 0.0, 0.0, 0.0, 0.0, 0.03024075, -0.02491312, -0.07814609, -0.00452474, 0.11320218, 0.06240921, 0.05600274, 0.09514139, 0.24839361, 0.0868828, 0.08859138, 0.05623244, 0.02611939, 0.06396591, 0.04952518, 0.02164099, 0.0338321, -0.01207925, -0.02539005, -0.00441226, -0.03705283, -0.06566294, -0.01031526, -0.00211347, 0.030516, -0.0066371, -0.05382434 };  // Copia i pesi da Python
static const float bias = -0.8728377955301339;

int classify(float input[]) {
  double sum = bias;
  for (int i = 0; i < (sizeof(weights) / sizeof(double)); i++) {
    sum += input[i] * weights[i];
  }
  if (stream_FFT)
    Serial.println(sum);
  return sum >= 6 ? 1 : 0;  // Soglia 0 per classificazione
}

#endif

#ifdef SVM_KERNEL_POLY

#include <math.h>

// Parametri SVM
const int numSV = 408;       // Numero di support vectors
const int numFeatures = 32;  // Numero di features
static const float supportVectors[numSV][numFeatures] = {
  { 0.000000, 0.000000, 0.000000, 0.000000, 0.000000, -0.198193, -0.457227, -0.629256, -0.515571, -0.380538, -0.439900, -0.384909, -0.309029, -0.254948, -0.339293, -0.604928, -0.332088, -0.332454, -0.537480, 0.942536, -0.295264, 0.508075, 0.270381, -0.130020, 1.361696, -0.399005, 0.752899, 1.098828, -0.087826, -0.527920, -0.151138, -0.596651 },
  { 0.000000, 0.000000, 0.000000, 0.000000, 0.000000, -0.249698, -0.193581, -0.576673, -0.341776, -0.388018, -0.510794, -0.136417, -0.281484, -0.283855, -0.265543, -0.546621, -0.018929, 0.256995, -0.253095, -0.323631, 0.071772, 0.580190, 0.108107, -0.476013, 0.135681, 1.351307, 0.505654, -0.308107, -0.685981, 0.525307, 0.150485, -0.111137 },
  { 0.000000, 0.000000, 0.000000, 0.000000, 0.000000, -0.354573, -0.615250, -0.573097, -0.287259, -0.372778, -0.452283, -0.382116, -0.354243, -0.323926, -0.271757, -0.202545, -0.306950, -0.503914, -0.824267, -0.975370, -0.257575, -0.384441, -0.968319, -0.316933, 0.194428, 1.248545, -1.219840, 0.525278, 0.331898, 1.421259, 1.139427, -0.856756 },
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  { 0.000000, 0.000000, 0.000000, 0.000000, 0.000000, -0.021112, -0.374462, 0.086040, -0.012981, -0.349081, -0.244059, -0.450839, 0.186622, -0.431251, 0.155501, -0.006482, 0.023299, 0.194975, -0.478727, -0.083945, -0.656073, 1.248792, 0.278936, -0.042727, -1.039105, 0.895277, 0.396760, -0.885928, 0.999380, 0.661464, 0.674953, 0.166305 }
};
static const float dualCoefs[numSV] = { -0.061898, -1.000000, -0.754194, -1.000000, -0.976504, -1.000000, -1.000000, -0.428730, -0.701596, -1.000000, -0.154579, -0.124817, -1.000000,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 0.768367, 1.000000 };
static const float bias = -0.972276;  // Carica il bias da Python
static const float c = 1;             // Costante del kernel (tipicamente 1)
static const int d = 2;               // Grado del polinomio, impostato a 2 (quadratico), cambia se necessario

// Funzione di kernel polinomiale
float polyKernel(float x[], const float sv[]) {
  float sum = 0.0;
  for (int i = 0; i < numFeatures; i++) {
    sum += x[i] * sv[i];
  }
  return pow(sum + c, d);  // (x * y + c)^d
}

// Funzione di decisione SVM
int classify(float input[]) {
  float sum = bias;
  for (int i = 0; i < numSV; i++) {
    sum += dualCoefs[i] * polyKernel(input, supportVectors[i]);
  }
  if (stream_FFT)
    Serial.println(sum);
  return sum >= 0 ? 1 : 0;  // Soglia decisionale
}

#endif




void add_to_elements(bool b) {
  data_elements[elements_cursor++] = { millis(), b };

  if (elements_cursor == elements_size) {
    for (unsigned int i = 0; i < elements_size; i++)
      send_element(data_elements + i);
    elements_cursor = 0;
  }
}

// Variabili configurabili
const unsigned long attesaFiltraggio = 1000;  // 1000ms per ignorare falsi positivi
const unsigned long attesaPrimoBeep = 1000;   // 1s prima del primo beep
const unsigned long attesaBeep = 3000;        // 3s tra un beep e l'altro
const int numeroMaxBeep = 3;                  // Numero massimo di beep prima dell'allarme
const unsigned long periodoAttesa = 8000;     // 2s per considerare interrotto l'evento
const unsigned long periodoGrazia = 60000;    // 60s di grazia per dare tempo di mettersi a letto

const unsigned long filtraggioIniziale = 100;
const uint8_t campioniFiltraggio = 10;

// Variabili di stato
bool eventoInCorso = false;
unsigned long inizioEvento = 0;
unsigned long ultimoPositivo = 0;
int beepCounter = 0;
unsigned long ultimoBottone = 0;

unsigned long inizioFiltraggio = 0;
unsigned long ultimoCampione = 0;
unsigned long periodoCampione = filtraggioIniziale / campioniFiltraggio;
bool filtraggio[campioniFiltraggio] = { false };
uint8_t indice_campione = campioniFiltraggio - 1;

bool started_sent = false;

void trigger_system(int classificazione, unsigned long tempoAttuale) {

#ifndef NIGHT_SIMULATION_SERIAL
  add_to_elements(classificazione);

#endif


  bool esitoFiltraggio = false;
  bool filtraggioCompletato = false;

  if (tempoAttuale - ultimoCampione >= periodoCampione) {
    ultimoCampione = tempoAttuale;
    filtraggio[indice_campione++] = classificazione;
    if (indice_campione == campioniFiltraggio) {
      filtraggioCompletato = true;
      uint8_t count = 0;
      for (uint8_t i = 0; i < campioniFiltraggio; i++)
        if (filtraggio[i])
          count++;
      esitoFiltraggio = count >= (2 * (campioniFiltraggio / 3));
      indice_campione = 0;
#ifndef NIGHT_SIMULATION_SERIAL
      if (stream_FFT) {
        Serial.print(campioniFiltraggio);
        Serial.print(" in ");
        Serial.print(tempoAttuale - inizioFiltraggio);
        Serial.print("ms\tEsito");
        Serial.println(esitoFiltraggio);
      }
#endif
      inizioFiltraggio = tempoAttuale;
    }
  }

  if (tempoAttuale - ultimoBottone < periodoGrazia || !filtraggioCompletato) {
    return;
  }

  #ifdef NIGHT_SIMULATION_SERIAL
  if (alarm_running && !esitoFiltraggio) {
    alarm_running = false;
    tone_sel = tone_num - 1;

    eventoInCorso = false;
    beepCounter = 0;
    ultimoBottone = tempoAttuale;
    send_event_serial(BUTTON, tempoAttuale);
    send_event_serial(ALARM_STOP, tempoAttuale);
    return;
  }

#endif


  if (esitoFiltraggio) {  // Se il segnale indica clenching

    if (!eventoInCorso) {
      if (tempoAttuale - ultimoPositivo < periodoAttesa) {
        // Se l'evento torna positivo entro 10s, continua l'evento precedente
        eventoInCorso = true;
#ifndef NIGHT_SIMULATION_SERIAL
        Serial.println("Evento ripreso!");
        send_event(CONTINUED);
#else
        send_event_serial(CONTINUED, tempoAttuale);

#endif

      } else {
        // Nuovo evento
        inizioEvento = tempoAttuale;
        eventoInCorso = true;
        beepCounter = 0;
#ifndef NIGHT_SIMULATION_SERIAL
        Serial.println("Nuovo evento iniziato");
        send_event(DETECTED);
#else
        send_event_serial(DETECTED, tempoAttuale);
#endif
      }
    }
    ultimoPositivo = tempoAttuale;

    if (tempoAttuale - inizioEvento > attesaFiltraggio) {
      if (tempoAttuale - inizioEvento > attesaPrimoBeep + beepCounter * attesaBeep) {
        if (beepCounter < numeroMaxBeep) {
          if (beepCounter == 0) {
#ifndef NIGHT_SIMULATION_SERIAL
            send_event(CLENCH_START);
#else
            send_event_serial(CLENCH_START, tempoAttuale);
#endif
            started_sent = true;
          }
          warning_beep();
#ifndef NIGHT_SIMULATION_SERIAL
          Serial.println("Beep!");
          send_event(BEEP);
#else
          send_event_serial(BEEP, tempoAttuale);

#endif
          beepCounter++;
        } else if (!alarm_running) {
#ifndef NIGHT_SIMULATION_SERIAL
          Serial.println("Allarme attivato!");
          send_event(ALARM_START);
#else
          send_event_serial(ALARM_START, tempoAttuale);

#endif
          trigger_alarm();
        }
      }
    }

  } else {  // Se il segnale torna negativo
    if (eventoInCorso && (tempoAttuale - ultimoPositivo > periodoAttesa)) {
      eventoInCorso = false;
      if (started_sent) {
#ifndef NIGHT_SIMULATION_SERIAL
        Serial.println("Evento terminato");
        send_event(CLENCH_STOP);
#else
        send_event_serial(CLENCH_STOP, tempoAttuale);

#endif
        started_sent = false;
      }

      //tone(BUZZER, 1700, 100);
    }
  }
}

void loop() {
#ifdef NIGHT_SIMULATION_SERIAL

  String input;
  while (Serial.available() > 0) {
    input = Serial.readStringUntil('\n');
    int semicolonPos = input.indexOf(';');
    if (semicolonPos != -1) {
      String valueUL = input.substring(0, semicolonPos);
      String valueB = input.substring(semicolonPos + 1);
      unsigned long mstime = valueUL.toInt();
      bool val = valueB.equals("false") ? false : true;
      // Process the valueUL and valueB here

      //Serial.print(mstime);
      //Serial.print(";");
      //Serial.println(val);

      trigger_system(val, mstime);

    } else {
      // Handle invalid input
    }
  }

#else

#ifdef SIMULATION
  generate_samples();
#else
  collect_samples();
#endif

  FFT.windowing(FFTWindow::Hamming, FFTDirection::Forward);
  FFT.compute(FFTDirection::Forward);
  FFT.complexToMagnitude();

  uint8_t i = 255;
  while (freq_bin * (++i) <= 60)
    vReal[i] = 0;

  trigger_system(classify(vReal), millis());

#ifdef WIFI_OUT
  if (stream_FFT) {
    send_to_udp();
    read_from_udp();
  }
#else
  send_serial();
#endif

  alarm_loop();
  bool btread = digitalRead(BUTTON);
  button_input_long.update(btread);
  button_input_short.update(btread);

#endif
}

static void button_short_press(uint8_t btnId, uint8_t btnState) {
  if (btnState == BTN_PRESSED) {
    tone(BUZZER, 1000, 100);
    alarm_running = false;
    tone_sel = tone_num - 1;

    eventoInCorso = false;
    beepCounter = 0;
    ultimoBottone = millis();

#if defined(ARDUINO_UNOR4_WIFI)
    matrix.clear();
#endif
#ifdef WIFI_OUT
    send_event(BUTTON_PRESS);
#else
    send_button_serial();
#endif
  }
}

static void button_long_press(uint8_t btnId, uint8_t btnState) {
  if (btnState == BTN_PRESSED) {
    stream_FFT = !stream_FFT;
    tone(BUZZER, stream_FFT ? 2000 : 2400, 50);
    delay(100);
    tone(BUZZER, !stream_FFT ? 2000 : 2400, 50);
  }
}
